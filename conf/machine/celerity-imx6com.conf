## conf/machine/celerity-imx6com.conf
```bitbake
#@TYPE: Machine
#@NAME: CelerityEDS iMX6COM
#@SOC: i.MX6Q
#@DESCRIPTION: Machine configuration for CelerityEDS iMX6COM
#@MAINTAINER: Warranyu Walton <wwalton@celerityeds.com>
#
# By default, this machine will build for the standard Quad-Core, 2GB
# option.
#
# To build U-Boot for other CPU or memory combinations, you can set
# the UBOOT_MACHINE variable in your local.conf according to the
# following table:
#
# Processor           Memory    Configuration
# --------------      ------    --------------------
# i.MX6Quad/Dual        2GB     celerity_iMX6qCOM2g
#

include conf/machine/include/imx-base.inc
include conf/machine/include/tune-cortexa9.inc

SOC_FAMILY = "mx6:mx6dl:mx6q"

KERNEL_DEVICETREE = "imx6q-celerityCOM.dtb"
KERNEL_IMAGETYPE = "uImage"

PREFERRED_PROVIDER_u-boot = "u-boot-celerity"
PREFERRED_PROVIDER_virtual/kernel = "linux-celerity"
PREFERRED_VERSION_linux-celerity = "3.10.17"

# Use SPI NOR U-Boot by default
IMAGE_BOOTLOADER ?= ""

UBOOT_MACHINE ?= "celerity_iMX6qCOM2g_defconfig"

SERIAL_CONSOLE = "115200 ttymxc1"

MACHINE_EXTRA_RRECOMMENDS += "linux-firmware-wl12xx"

MACHINE_FEATURES += " pci wifi bluetooth"
```
